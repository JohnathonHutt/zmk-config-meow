## config/boards/shields/meow/Kconfig.deconfig
```kconfig
# Copyright (c) 2023 The ZMK Contributors
# SPDX-License-Identifier: MIT

if SHIELD_MEOW

config ZMK_KEYBOARD_NAME
    default "Meow"

endif
```
